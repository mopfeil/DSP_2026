/*
 * Sheet 10 -- Exercise 10.3 a): real-time knock band-pass on the ESP32
 * (reference solution)
 *
 * Wiring (diagram.json): engine-sim KNOCK -> GPIO34 (ADC1), TDC -> GPIO27,
 * CAM -> GPIO26, KNK (ground truth) -> GPIO25.
 *
 * Sampling: fs = 25 kHz (TS_US = 40 us) with a deadline loop. The engine-sim
 * chip updates its analog output every 20 us (50 kHz), so every ADC sample
 * sees a fresh chip value at the same phase of the 20 us grid.
 *
 * Every sample is filtered by
 *   - the FIR band-pass kf_fir[] (float, 83 taps, doubled circular buffer)
 *   - the IIR biquad cascade kf_sos[][] (float, transposed direct form II)
 * Coefficients: knock_filter.h, generated by filterdesign.c (Exercise 10.2).
 *
 * After the TDC of cylinder 1 (TDC pulse while CAM is HIGH) NREC samples
 * of x, y_fir, y_iir and the KNK pin are recorded and printed as CSV
 * (columns n,x,y_fir,y_iir,knk; x and y in volts at the sensor). A comment
 * line "# rec,..." gives the window energies 10..70 deg ATDC.
 * Copy the Serial Monitor output into JSLinux for the analysis.
 */
#include "knock_filter.h"

const int PIN_KNOCK = 34;
const int PIN_TDC = 27;
const int PIN_CAM = 26;
const int PIN_KNK = 25;

const unsigned long TS_US = 40;              /* fs = 25 kHz            */
const float V_PER_LSB = 3.3f / 4095.0f;      /* 12-bit ADC, 0..3.3 V   */
const float CHIP_GAIN = 0.6f;                /* KNOCK = 1.65 V + 0.6 x */
const int ADC_OFFSET = 2048;                 /* 1.65 V                 */

#define NREC 300                             /* 12 ms after TDC        */
#define SETTLE 200                           /* samples before re-arm  */

/* ---------------- FIR: doubled circular buffer ----------------------
   every sample is written twice (pos and pos+N), so the newest N samples
   are always contiguous: buf[pos .. pos+N-1], newest at pos+N-1      */
static float fir_buf[2 * KF_FIR_N];
static int fir_pos = 0;

static float fir_step(float x)
{
    fir_buf[fir_pos] = x;
    fir_buf[fir_pos + KF_FIR_N] = x;
    if (++fir_pos == KF_FIR_N) fir_pos = 0;
    const float *p = &fir_buf[fir_pos + KF_FIR_N - 1];   /* newest */
    float acc = 0.0f;
    for (int k = 0; k < KF_FIR_N; k++) acc += kf_fir[k] * p[-k];
    return acc;
}

/* ---------------- IIR: biquad cascade, transposed direct form II ---- */
static float s1[KF_NSEC], s2[KF_NSEC];

static float iir_step(float x)
{
    for (int k = 0; k < KF_NSEC; k++) {
        const float *c = kf_sos[k];          /* b0 b1 b2 a1 a2 */
        float y = c[0] * x + s1[k];
        s1[k] = c[1] * x - c[3] * y + s2[k];
        s2[k] = c[2] * x - c[4] * y;
        x = y;
    }
    return x;
}

/* ---------------- TDC interrupt ------------------------------------- */
volatile bool tdc_flag = false;
volatile unsigned long tdc_us = 0, tdc_period_us = 20000;

void IRAM_ATTR on_tdc()
{
    unsigned long t = micros();
    tdc_period_us = t - tdc_us;              /* 180 deg crank angle */
    tdc_us = t;
    tdc_flag = true;
}

/* ---------------- recording ------------------------------------------ */
static float rx[NREC], rf[NREC], ri[NREC];
static uint8_t rk[NREC];
static int nrec = -1;                        /* -1: not recording */
static int settle = SETTLE;
static unsigned long rec_period_us;
static unsigned long t_next;
static unsigned long nrecords = 0;

static void benchmark()
{
    /* indicative only: Wokwi is not cycle accurate */
    unsigned long t0 = micros();
    float s = 0.0f;
    for (int i = 0; i < 2000; i++) s += fir_step((i & 7) * 0.01f);
    unsigned long t1 = micros();
    for (int i = 0; i < 2000; i++) s += iir_step((i & 7) * 0.01f);
    unsigned long t2 = micros();
    Serial.printf("# benchmark: FIR %.2f us/sample, IIR %.2f us/sample (%d MAC vs %d mult) %g\n",
                  (t1 - t0) / 2000.0, (t2 - t1) / 2000.0, KF_FIR_N, 5 * KF_NSEC, s * 0.0);
    memset(fir_buf, 0, sizeof fir_buf);
    memset(s1, 0, sizeof s1);
    memset(s2, 0, sizeof s2);
}

static void print_record()
{
    /* window 10..70 deg ATDC in samples, from the measured TDC period */
    float us_per_deg = rec_period_us / 180.0f;
    int n10 = (int)(10.0f * us_per_deg / TS_US), n70 = (int)(70.0f * us_per_deg / TS_US);
    float ef = 0.0f, ei = 0.0f;
    int knk = 0;
    if (n70 > NREC) n70 = NREC;
    for (int n = n10; n < n70; n++) { ef += rf[n] * rf[n]; ei += ri[n] * ri[n]; }
    for (int n = 0; n < NREC; n++) knk |= rk[n];
    Serial.printf("# rec %lu, rpm %.0f, window samples %d..%d, E_fir %.4f, E_iir %.4f, knk %d\n",
                  nrecords, 30.0e6f / rec_period_us, n10, n70, ef, ei, knk);
    Serial.println("n,x,y_fir,y_iir,knk");
    for (int n = 0; n < NREC; n++)
        Serial.printf("%d,%.4f,%.4f,%.4f,%d\n", n, rx[n], rf[n], ri[n], rk[n]);
}

void setup()
{
    Serial.setTxBufferSize(4096);
    Serial.begin(115200);
    analogReadResolution(12);
    pinMode(PIN_TDC, INPUT);
    pinMode(PIN_CAM, INPUT);
    pinMode(PIN_KNK, INPUT);
    attachInterrupt(digitalPinToInterrupt(PIN_TDC), on_tdc, RISING);
    Serial.printf("# Sheet 10 ESP32 knock band-pass, fs = %d Hz\n", (int)(1000000UL / TS_US));
    benchmark();
    t_next = micros();
}

void loop()
{
    while ((long)(micros() - t_next) < 0) { }
    t_next += TS_US;

    int adc = analogRead(PIN_KNOCK);
    float x = (adc - ADC_OFFSET) * V_PER_LSB / CHIP_GAIN;   /* sensor volts */
    float yf = fir_step(x);
    float yi = iir_step(x);

    if (settle > 0) settle--;
    if (nrec < 0) {
        if (tdc_flag) {
            tdc_flag = false;
            if (settle == 0 && digitalRead(PIN_CAM) == HIGH) {   /* cylinder 1 */
                nrec = 0;
                rec_period_us = tdc_period_us;
            }
        }
    }
    if (nrec >= 0) {
        rx[nrec] = x; rf[nrec] = yf; ri[nrec] = yi;
        rk[nrec] = (uint8_t)digitalRead(PIN_KNK);
        if (++nrec == NREC) {
            nrecords++;
            print_record();                  /* takes ~1 s at 115200 baud  */
            nrec = -1;
            settle = SETTLE;                 /* filters see a gap: settle  */
            tdc_flag = false;
            t_next = micros();               /* re-synchronise the deadline */
        }
    }
}
